## drivers/can_test_link/Kconfig
```kconfig
menuconfig DRIVERS_CAN_TEST_LINK
	bool "can_test_link"
	default n
	---help---
		Enable support for CAN test link module
```

## src/drivers/actuators/dj_mk/Kconfig
```kconfig
menuconfig DRIVERS_ACTUATORS_DJ_MK
	bool "dj_mk"
	default n
	---help---
		Enable support for ASMG-MD series servo control via CAN bus
```

## src/drivers/imu/damiao/dmimu_l1/Kconfig
```kconfig
menuconfig DRIVERS_IMU_DAMIAO_DMIMU_L1
	bool "DM-IMU L1 CAN driver"
	default n
	---help---
		Enable support for Damiao IMU L1 via CAN bus.

		This driver supports:
		- Accelerometer and gyroscope data
		- Attitude (Euler angles and quaternions)
		- Active and request modes
		- Sensor calibration
		- Parameter configuration
```

## src/modules/dive_bombing_control/Kconfig
```kconfig
menuconfig MODULES_DIVE_BOMBING_CONTROL
	bool "dive_bombing_control"
	default n
	---help---
		Enable support for dive bombing control module
```

## src/modules/ground_radar/Kconfig
```kconfig
menuconfig MODULES_GROUND_RADAR
	bool "ground_radar"
	default n
	---help---
		Enable support for ground_radar
```

## src/modules/proportional_navigation/Kconfig
```kconfig
menuconfig MODULES_PROPORTIONAL_NAVIGATION
	bool "proportional_navigation"
	default n
	---help---
		Enable support for proportional navigation guidance
```

## src/modules/target_frame_udp/Kconfig
```kconfig
menuconfig MODULES_TARGET_FRAME_UDP
	bool "target_frame_udp"
	default n
	depends on BOARD_ETHERNET
	---help---
		Bidirectional UDP transport for the custom radar target-frame protocol.
```
